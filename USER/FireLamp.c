#include "firelamp.h"
#include "stm8l15x.h"
#include "main.h"


void SEND_CODE_DATA(uint8_t ch[],int dataLen,int gpio_pinx ,uint32_t time);
void RGBLightCtr(uint8_t RValue, uint8_t GValue, uint8_t BValue , uint8_t Brightness ,uint16_t Time ,uint8_t count);


//GRB----CLOSE
uint8_t test[] = { 0x00, 0x00, 0x00, 0x00, 0x00, 0x00, 0x00, 0x00, 0x00, 0x00, 0x00, 0x00, 
                      0x00, 0x00, 0x00, 0x00, 0x00, 0x00, 0x00, 0x00, 0x00, 0x00, 0x00, 0x00, 
                      0x00, 0x00, 0x00, 0x00, 0x00, 0x00, 0x00, 0x00, 0x00, 0x00, 0x00, 0x00,
                      0x00, 0x00, 0x00, 0x00, 0x00, 0x00, 0x00, 0x00, 0x00, 0x00, 0x00, 0x00,
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                      0x00, 0x00, 0x00,
};

uint8_t OFFGroup[] = { 0x00, 0x00, 0x00, 0x00, 0x00, 0x00, 0x00, 0x00, 0x00, 0x00, 0x00, 0x00, 
                      0x00, 0x00, 0x00, 0x00, 0x00, 0x00, 0x00, 0x00, 0x00, 0x00, 0x00, 0x00, 
                      0x00, 0x00, 0x00, 0x00, 0x00, 0x00, 0x00, 0x00, 0x00, 0x00, 0x00, 0x00,
                      0x00, 0x00, 0x00, 0x00, 0x00, 0x00, 0x00, 0x00, 0x00, 0x00, 0x00, 0x00,
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                      0x00, 0x00, 0x00,
};
#if 1
//white
uint8_t WhiteGroup[] = {254,254,254, 254,254,254, 254,254,254, 254,254,254,
                        254,254,254, 254,254,254, 254,254,254, 254,254,254,
                        254,254,254, 254,254,254, 254,254,254, 254,254,254,
                        254,254,254, 254,254,254, 254,254,254, 254,254,254,
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                        254,254,254, 
};
#endif

//G
uint8_t GGroup[] = { 0xff,0x00, 0x00, 0xff, 0x00, 0x00, 0xff,0x00, 0x00, 0xff, 0x00, 0x00, 
                    0xff,0x00, 0x00, 0xff, 0x00, 0x00, 0xff,0x00, 0x00, 0xff, 0x00, 0x00,  
                    0xff,0x00, 0x00, 0xff, 0x00, 0x00, 0xff,0x00, 0x00, 0xff, 0x00, 0x00, 
                    0xff,0x00, 0x00, 0xff, 0x00, 0x00, 0xff,0x00, 0x00, 0xff, 0x00, 0x00, 
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                    0xff,0x00, 0x00,
};
//B
uint8_t BGroup[] = {  0x00, 0x00, 0xff, 0x00, 0x00, 0xff, 0x00, 0x00, 0xff, 0x00, 0x00, 0xff, 
                      0x00, 0x00, 0xff, 0x00, 0x00, 0xff, 0x00, 0x00, 0xff, 0x00, 0x00, 0xff,  
                      0x00, 0x00, 0xff, 0x00, 0x00, 0xff, 0x00, 0x00, 0xff, 0x00, 0x00, 0xff, 
                      0x00, 0x00, 0xff, 0x00, 0x00, 0xff, 0x00, 0x00, 0xff, 0x00, 0x00, 0xff,
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                      0x00, 0x00, 0xff,
};
//R
uint8_t RGroup[] = { 0x00, 0xff,0x00,  0x00, 0xff,0x00,0x00, 0xff,0x00, 0x00, 0xff,0x00,
                    0x00, 0xff,0x00,  0x00, 0xff,0x00,0x00, 0xff,0x00, 0x00, 0xff,0x00, 
                    0x00, 0xff,0x00,  0x00, 0xff,0x00,0x00, 0xff,0x00, 0x00, 0xff,0x00,
                    0x00, 0xff,0x00,  0x00, 0xff,0x00,0x00, 0xff,0x00, 0x00, 0xff,0x00, 
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                    0x00, 0xff,0x00,
};

//FIRE  49 LED
uint8_t FireGroup[] = { 0x00, 0x00,0x00,  0x00, 0x00,0x00,0x00, 0x00,0x00, 0x00, 0x00,0x00,
                    0x00, 0x00,0x00,  0x00, 0x00,0x00,0x00, 0x00,0x00, 0x00, 0x00,0x00, 
                    0x00, 0x00,0x00,  0x00, 0x00,0x00,0x00, 0x00,0x00, 0x00, 0x00,0x00,
                    0x00, 0x00,0x00,  0x00, 0x00,0x00,0x00, 0x00,0x00, 0x00, 0x00,0x00, 
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                    0x00, 0x00,0x00,  
};

uint8_t IceEffect[] = {  65, 10,161,  65, 10,161, 65, 10,161, 65, 10,161,
                         65, 10,161,  65, 10,161, 65, 10,161, 65, 10,161, 
                         65, 10,161,  65, 10,161, 65, 10,161, 65, 10,161,
                         65, 10,161,  65, 10,161, 65, 10,161, 65, 10,161,
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                         65, 10,161,  65, 10,161,                    161,
};

uint8_t LedGroup[] = {6,7,7,9,7,7,6};

//亮度调节不能循环运行，否则每次亮度值都会根据输入的亮度进行递减，比如80亮度值，每次循环都会递减20%亮度
void APP_LED_LOOP(uint8_t num , uint8_t *color ,uint16_t time, uint8_t brightness)
{
  uint8_t tmp,k;
  
  k = num * 3 ;
  if(brightness > 100)
    brightness = 100;
  brightness = brightness * 40 /100;
  for(tmp = 0; tmp < k+1; tmp++)
  {
    color[tmp] = color[tmp] * brightness /40 ;
    
  }
  SEND_CODE_DATA(color ,k, FIRE_LAMP_PIN,time);
}

void PointCTRL(uint8_t *color ,uint8_t RValue,uint8_t GValue,uint8_t BValue,uint8_t LED,uint8_t brightness,uint8_t time)
{
  LED*=3;
  if(brightness > 100)
    brightness = 100;
  brightness = brightness * 40 /100;
  color[LED] = GValue * brightness /40;
  color[LED+1] = RValue * brightness /40;
  color[LED+2] = BValue * brightness /40;
  SEND_CODE_DATA(color ,LED, FIRE_LAMP_PIN,time);
}


uint8_t RFLAG = 0;
uint8_t GFLAG = 0;
uint8_t BFLAG = 0;
uint8_t BRTFLAG = 0;
uint8_t LEDFLAG = 0;
void APP_RGBLoop(void)
{
  
  APP_LED_LOOP(49, RGroup ,10000, 100);
  Delay(50000);
  APP_LED_LOOP(49, GGroup ,10000, 100);
  Delay(50000);
  APP_LED_LOOP(49, BGroup ,10000, 100);
  Delay(50000);
  
}

//smallfire
uint8_t GTmp = 20,RTmp = 200,BRT= 40,Lednum = 10;
uint8_t tmp3 = 70;
void APP_SmallFIRE(void)
{
  uint8_t tmp1 ;
  
  for(tmp1=144 ; tmp1 > 101 ; tmp1-=3)
    {
      FireGroup[tmp1] = tmp1-100; 
      FireGroup[tmp1+1] = tmp1+100;
      
    }
  
    for(tmp1=48 ; tmp1 < 101 ; tmp1+=3)
    {
      FireGroup[tmp1] = 20; 
      FireGroup[tmp1+1] = 100+tmp1;
      

    }
  
  for(tmp1=0 ; tmp1 < 48 ; tmp1+=3 )
    {
      FireGroup[tmp1] = 10; 
      FireGroup[tmp1+1] = 200+tmp1;
      
    }
    tmp3+=8;
  if(tmp3 > 80)
    tmp3 = 50;
  Lednum+=2;
  if(Lednum > 49)
    Lednum = 0;
    APP_LED_LOOP(Lednum, FireGroup ,10000, Lednum+50);
    APP_LED_LOOP(49, FireGroup ,15000, tmp3);
}
//bigfire
void APP_BigFIRE(void)
{
  uint8_t tmp1 ;
  
  for(tmp1=144 ; tmp1 > 101 ; tmp1-=6)
    {
      FireGroup[tmp1] = 15; 
      FireGroup[tmp1+1] = tmp1-30;
      
    }
  
    for(tmp1=48 ; tmp1 < 101 ; tmp1+=3)
    {
      FireGroup[tmp1] = 5; 
      FireGroup[tmp1+1] = 150+Lednum;
    }
  
  for(tmp1=0 ; tmp1 < 48 ; tmp1+=6 )
    {
      FireGroup[tmp1] = 10; 
      FireGroup[tmp1+1] = 120+Lednum;
      
    }
    tmp3+=8;
  if(tmp3 > 100)
    tmp3 = 80;
  Lednum+=10;
  if(Lednum > 49)
    Lednum = 0;
    APP_LED_LOOP(Lednum, FireGroup ,6000, Lednum+50);
    APP_LED_LOOP(49, FireGroup ,12000, tmp3);
}
  
#if 0
void APP_BigFIRE(void)
{
  uint8_t tmp1 ;
  for(tmp1 = 0; tmp1 < 146 ;tmp1+=3)
  {
    FireGroup[tmp1] = GTmp;
    FireGroup[tmp1+1] = RTmp;
    if(GFLAG)
      GTmp+= 10 ;
    else
      GTmp-= 6 ;
    if(RFLAG)
      RTmp-= GTmp ;
    else
      RTmp+= GTmp ;
    if(BRTFLAG)
      BRT +=GTmp;
    else
      BRT -=GTmp;
    if(RTmp < 170)
      RFLAG=0;
    if(RTmp > 246)
      RFLAG=1;
    if(GTmp < 10)
      GFLAG=1;
    if(GTmp > 30)
      GFLAG=0;
    if(BRT>70)
      BRTFLAG = 0;
    if(BRT<50)
      BRTFLAG = 1;
  
  }
  
    Lednum+=6;
 
  if(Lednum > 49)
    Lednum = 0;
    APP_LED_LOOP(Lednum, FireGroup ,10300, 75);
  APP_LED_LOOP(49, FireGroup ,18300, Lednum+40);


}
#endif

//ice
void APP_ICE(void)
{
  
  APP_LED_LOOP(49, IceEffect ,10, 100);

}
uint8_t ICER = 10, ICEG = 65, ICEB = 191;
uint8_t SwitchFlag = 0;
uint16_t BlinkIntervalTime = 10;
uint8_t BlinkFlag = 0;
uint8_t tmp1 = 70;
void APP_COLDFIRE(void)
{
  uint8_t j =0;
  for(j = 48; j < 96;j+=3)
      {
        IceEffect[j] = ICEG ;
        IceEffect[j+1] = ICER ;
        IceEffect[j+2] = ICEB ;
        ICEG+=3;
        ICER-=3;
        ICEB+=18;
        if(ICEG > 100)
          ICEG = 55;
        if(ICER < 4)
          ICER = 32;
        if(ICEB > 125)
          ICEB = 65;
        
      }
      for(j = 0; j < 47;j+=3)
      {
        IceEffect[j] = ICEG ;
        IceEffect[j+1] = ICER ;
        IceEffect[j+2] = ICEB ;
        ICEG+=3;
        ICER-=3;
        ICEB+=24;
        if(ICEG > 90)
          ICEG = 55;
        if(ICER < 4)
          ICER = 32;
        if(ICEB > 220)
          ICEB = 45;
       
      }
      for(j = 96; j < 147;j+=3)
      {
        IceEffect[j] = ICEG ;
        IceEffect[j+1] = ICER ;
        IceEffect[j+2] = ICEB ;
        ICEG+=3;
        ICER-=3;
        ICEB+=20;
        if(ICEG > 80)
          ICEG = 55;
        if(ICER < 4)
          ICER = 32;
        if(ICEB > 220)
          ICEB = 105;
        
      }
      if(BlinkFlag == 0)
      {
        BlinkIntervalTime += 400 ;
        tmp1+=4;
      }
      
      if(BlinkIntervalTime > 10000)
      {
        BlinkFlag = 1;
      }
      if(BlinkFlag == 1)
      {
        BlinkIntervalTime -= 560 ;
        tmp1-=5;
      }
      
      if(BlinkIntervalTime < 2610)
      {
        BlinkFlag = 0;
      }
    //tmp1+=6;
    if(tmp1 > 100)
      tmp1 = 90;
    if(tmp1 <80)
      tmp1 = 100;
      PointCTRL(IceEffect, 0,0,50,ICER+4,100,BlinkIntervalTime);
      APP_LED_LOOP(49 ,IceEffect , BlinkIntervalTime ,tmp1);

}


//warmwhite
void APP_WARMWHITE(void)
{
  uint8_t tmp;
  for(tmp = 0; tmp < 147; tmp+=3)
  {
    WhiteGroup[tmp] = 55;
    WhiteGroup[tmp+1] = 220;
    WhiteGroup[tmp+2] = 0;
  }
  APP_LED_LOOP(49, WhiteGroup ,10, 100);
    
}

//Switchoff
void APP_SWITCHOFF(void)
{
  
  APP_LED_LOOP(49, OFFGroup ,10, 100);
    
}

//coldwhite
void APP_COLDWHITE(void)
{
  uint8_t tmp;
  for(tmp = 0; tmp < 147; tmp+=3)
  {
    WhiteGroup[tmp] = 120;
    WhiteGroup[tmp+1] = 66;
    WhiteGroup[tmp+2] = 130;
  }
  APP_LED_LOOP(49, WhiteGroup ,10, 100);
    
}

//RGB DRIVER
void RGBLightCtr(uint8_t RValue, uint8_t GValue, uint8_t BValue , uint8_t Brightness ,uint16_t Time ,uint8_t count)
{
  uint8_t Num,k;
  k = count*3;
  for(Num = 0 ; Num < k ;Num +=3)
  {
    test[Num] = GValue ;
    test[Num+1] = RValue ;
    test[Num+2] = BValue ;
  }
  APP_LED_LOOP(count, test, Time, Brightness);
}


void LampGpioInit(void)
{
  GPIO_Init(FIRE_LAMP_PORT, FIRE_LAMP_PIN, GPIO_Mode_Out_PP_Low_Fast);
  GPIO_Init(TOUCH_PORT, TOUCH_PIN, GPIO_Mode_In_FL_IT);
  EXTI_SetPinSensitivity(EXTI_Pin_4, EXTI_Trigger_Rising);
  
}

void SEND_CODE_DATA(uint8_t ch[],int dataLen,int gpio_pinx ,uint32_t time)  
{
  if(dataLen > 0 ){
   int len = dataLen;
   uint8_t num ;
   for(num = 0 ; num < len ; num++)
   {
     if(ch[num]&0x80){
       CODE_ONE(gpio_pinx);
     }else{
        CODE_ZERN(gpio_pinx);
     }
     if(ch[num]&0x40){
       CODE_ONE(gpio_pinx);
     }else{
        CODE_ZERN(gpio_pinx); 
     }
     if(ch[num]&0x20){
       CODE_ONE(gpio_pinx);
     }else{
        CODE_ZERN(gpio_pinx);
     }
     if(ch[num]&0x10){
       CODE_ONE(gpio_pinx); 
     }else{
        CODE_ZERN(gpio_pinx);
     }
     
     if(ch[num]&0x08){
       CODE_ONE(gpio_pinx);
     }else{
        CODE_ZERN(gpio_pinx); 
     }
     if(ch[num]&0x04){
       CODE_ONE(gpio_pinx);
     }else{
        CODE_ZERN(gpio_pinx);
     }
     if(ch[num]&0x02){
       CODE_ONE(gpio_pinx);
     }else{
        CODE_ZERN(gpio_pinx);
     }
     if(ch[num]&0x01){
       CODE_ONE(gpio_pinx);
     }else{
       CODE_ZERN(gpio_pinx);
     }
   }
  } 
  Delay(time);     
}







